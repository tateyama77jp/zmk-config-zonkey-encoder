## config/west.yml
```yaml
manifest:
  remotes:
    - name: zmkfirmware
      url-base: https://github.com/zmkfirmware
    - name: kureyakey
      url-base: https://github.com/kureyakey
    - name: caksoylar  # <-- new entry
      url-base: https://github.com/caksoylar  
    - name: kureyakey
      url-base: https://github.com/kureyakey
  projects:
    - name: zmk
      remote: zmkfirmware
      revision: v0.3
      import: app/west.yml
    - name: zmk-rgbled-widget
      remote: caksoylar
      revision: v0.3
    - name: cirque-input-module
 　　 remote: kureyakey
 　　 revision: main
  
  self:
    path: config
```
